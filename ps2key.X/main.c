#include "mcc_generated_files/mcc.h"

#define TIME_OFF -1
#define TIME_UP 0

// 受信タイムアウト
#define INT_TIMEOUT 100

// バッファ文字数
#define BUF_SIZE 4

//暫定
#define SHIFT_CODE 0x91                 //SHIFT
#define CTRL_CODE 0x51                  //CTRL
#define OFF_CODE 0x1f                   //キー解放

//小文字テーブル、大文字テーブル、特殊テーブル
const uint8_t table[3][256] =
{
    {   //小文字テーブル
        0x00, 0x01, 0x02, 0x03, 0x04, 0x05, 0x06, 0x07,
    /*          c                                       */
        0x08, 0x63, 0x0a, 0x0b, 0x0c, 0x0d, 0x0e, 0x0f,
        0x10, 0x11, 0x12, 0x13, 0x14, 0x15, 0x16, 0x17,
        0x18, 0x19, 0x1a, 0x1b, 0x1c, 0x1d, 0x1e, 0x1f,
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        0x40, 0x41, 0x42, 0x43, 0x44, 0x45, 0x46, 0x47,
    /*          e                                       */
        0x48, 0x65, 0x4a, 0x4b, 0x4c, 0x4d, 0x4e, 0x4f,
        0x50, 0x51, 0x52, 0x53, 0x54, 0x55, 0x56, 0x57,
    /*    g                                             */
        0x67, 0x59, 0x5a, 0x5b, 0x5c, 0x5d, 0x5e, 0x5f,
        0x60, 0x61, 0x62, 0x63, 0x64, 0x65, 0x66, 0x67,
        0x68, 0x69, 0x6a, 0x6b, 0x6c, 0x6d, 0x6e, 0x6f,
    /*    a                                             */
        0x61, 0x71, 0x72, 0x73, 0x74, 0x75, 0x76, 0x77,
        0x78, 0x79, 0x7a, 0x7b, 0x7c, 0x7d, 0x7e, 0x7f,
    /*                            i     k               */
        0x80, 0x81, 0x82, 0x83, 0x69, 0x6b, 0x86, 0x87,
    /*    d                                             */
        0x64, 0x89, 0x8a, 0x8b, 0x8c, 0x8d, 0x8e, 0x8f,
        0x90, 0x91, 0x92, 0x93, 0x94, 0x95, 0x96, 0x97,
    /*    b     h                                       */
        0x62, 0x68, 0x9a, 0x9b, 0x9c, 0x9d, 0x9e, 0x9f,
    /*                                  k               */
        0xa0, 0xa1, 0xa2, 0xa3, 0xa4, 0x6b, 0xa6, 0xa7,
    /*          f                                       */
        0xa8, 0x66, 0xaa, 0xab, 0xac, 0xad, 0xae, 0xaf,
        0xb0, 0xb1, 0xb2, 0xb3, 0xb4, 0xb5, 0xb6, 0xb7,
    /*    j                                             */
        0x6a, 0xb9, 0xba, 0xbb, 0xbc, 0xbd, 0xbe, 0xbf,
        0xc0, 0xc1, 0xc2, 0xc3, 0xc4, 0xc5, 0xc6, 0xc7,
        0xc8, 0xc9, 0xca, 0xcb, 0xcc, 0xcd, 0xce, 0xcf,
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        0xf8, 0xf9, 0xfa, 0xfb, 0xfc, 0xfd, 0xfe, 0xff
    },
    {   //大文字テーブル
        0x00, 0x01, 0x02, 0x03, 0x04, 0x05, 0x06, 0x07,
        0x08, 0x09, 0x0a, 0x0b, 0x0c, 0x0d, 0x0e, 0x0f,
        0x10, 0x11, 0x12, 0x13, 0x14, 0x15, 0x16, 0x17,
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        0xf8, 0xf9, 0xfa, 0xfb, 0xfc, 0xfd, 0xfe, 0xff
    },
    {   //特殊テーブル
        0x00, 0x01, 0x02, 0x03, 0x04, 0x05, 0x06, 0x07,
        0x08, 0x09, 0x0a, 0x0b, 0x0c, 0x0d, 0x0e, 0x0f,
        0x10, 0x11, 0x12, 0x13, 0x14, 0x15, 0x16, 0x17,
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        0xf8, 0xf9, 0xfa, 0xfb, 0xfc, 0xfd, 0xfe, 0xff
    }
};

int16_t timint = TIME_OFF;
int16_t bitCnt;                         //受信ビット数カウンタ
uint8_t tableSW;                        //SHIFT, CTRLのテーブル切り替え変数

// PS/2通信
uint8_t sciBuf;

void Int_CallBack(void);
void PB5Int_CallBack(void);
void mainTimer(void);
void initTsk(void);
void mainTsk(void);
void scanBit(void);
uint8_t trans(void);
void putByte(uint8_t inC);

/* Main application  */
void main(void)
{
    SYSTEM_Initialize();
    INTERRUPT_GlobalInterruptEnable();
    INTERRUPT_PeripheralInterruptEnable();
    TMR0_SetInterruptHandler(mainTimer);
    INT_SetInterruptHandler(Int_CallBack);
    
    // ここからユーザ定義のコード
    initTsk();                          // 初期化
    
    while (1)
    {
        mainTsk();                      // メインループ
    }
}

/* 初期化処理 */
void initTsk(void)
{
    sciBuf = 0x00;                      //バッファ初期化
    bitCnt = 0;                         //入力ビット数リセット
    tableSW = 0;                        //小文字テーブル
    putByte(0xff);
}

/* SDAのデータを保存する */
void scanBit(void)
{
    if(bitCnt <= 8)
    {   //8ビット変数があふれないなら
        sciBuf = (uint8_t)(sciBuf << 1);           //ビットシフト
        if(IO_RB1_GetValue())
        {   //入力ピンがhighなら
            sciBuf |= 0x01;             //ビットセット
        }
        else
        {   //入力ピンがLowなら
            sciBuf &= 0xfe;             //ビットリセット
        }
    }
    
    bitCnt++;
}

uint8_t trans(void)
{
    uint8_t ret = 0x00;                 //戻り値
    uint8_t ch = sciBuf;                //入力生データ
    
    if(ch == SHIFT_CODE)
    {   //SHIFTが押されたら
        tableSW = 1;                    //大文字テーブルに切り替え
    }
    else if(ch == CTRL_CODE)
    {   //CTRLが押されたら
        tableSW = 2;                    //特殊テーブルに切り替え
    }
    else if(ch == OFF_CODE)
    {   //キーが解放されたら
        tableSW = 0;                    //小文字テーブルに切り替え
    }
    else
    {   //普通のキーが押下されたら
        ret = table[tableSW][ch];
    }
    
    return ret;
}

/* 8ビット出力 */
void putByte(uint8_t inC)
{   //RA1,RA0,RA7,RA6,RB7,RB6,RB5.RB4
    RA1 = (inC & 0x80) ? 1 : 0;
    RA0 = (inC & 0x40) ? 1 : 0;
    RA7 = (inC & 0x20) ? 1 : 0;
    RA6 = (inC & 0x10) ? 1 : 0;
    RB7 = (inC & 0x08) ? 1 : 0;
    RB6 = (inC & 0x04) ? 1 : 0;
    RB5 = (inC & 0x02) ? 1 : 0;
    RB4 = (inC & 0x01) ? 1 : 0;
}

/* メイン処理 */
void mainTsk(void)
{
    if( timint == TIME_UP ){
        timint = TIME_OFF;
        putByte(trans());               //8ビット出力
        sciBuf = 0;                     //受信バッファクリア
        bitCnt = 0;
    }
}

/* EXT_INTの割り込みコールバック */
void Int_CallBack(void)
{   //RB0ピンの立下りで呼ばれるコールバック
    timint = INT_TIMEOUT;               //タイマ10ms設定
    scanBit();                          //1ビット入力 
}

/* タイマ管理 */
void mainTimer(void)
{    
    if( timint > TIME_UP )
    {   //1msごとにカウントダウン
        timint--;
    }
}
/* End of File */